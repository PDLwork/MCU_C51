#include <REGX52.H>
#include "UserDef.H"
#include "I2C.H"

/*******************************************************************************
* 函 数 名		: I2C_Start
* 函数功能		: I2C开始函数
* 输    入 		: 无
* 输    出		: 无
*******************************************************************************/
extern void I2C_Start(void)
{
	I2C_SDA = 1;
	I2C_SCL = 1;
	I2C_SDA = 0;
	I2C_SCL = 0;
}

/*******************************************************************************
* 函 数 名		: I2C_Stop
* 函数功能		: I2C结束函数
* 输    入 		: 无
* 输    出		: 无
*******************************************************************************/
extern void I2C_Stop(void)
{
	I2C_SDA = 0;
	I2C_SCL = 1;
	I2C_SDA = 1;
}

/*******************************************************************************
* 函 数 名		: I2C_SendByte
* 函数功能		: I2C发送字节函数
* 输    入 		: 无
* 输    出		: 无
*******************************************************************************/
extern void I2C_SendByte(INT8U Byte)
{
	INT8U i;
	for(i = 0; i < 8; i++)
	{
		I2C_SDA = Byte & (0x80 >> i);
		I2C_SCL = 1;
		I2C_SCL = 0;
	}
}

/*******************************************************************************
* 函 数 名		: I2C_ReceiveByte
* 函数功能		: I2C读取字节函数
* 输    入 		: 无
* 输    出		: Byte（读取字节内容）
*******************************************************************************/
extern INT8U I2C_ReceiveByte(void)
{
	INT8U i, Byte = 0x00;
	I2C_SDA = 1;
	for(i = 0; i < 8; i++)
	{
		I2C_SCL = 1;
		if(I2C_SDA)
			Byte |= (0x80 >> i);
		I2C_SCL = 0;
	}
	return Byte;
}

/*******************************************************************************
* 函 数 名		: I2C_SendAck
* 函数功能		: I2C发送应答函数
* 输    入 		: AckBit（发送应答内容：0表示单片机应答，1表示单片机不应答）
* 输    出		: 无
*******************************************************************************/
extern void I2C_SendAck(bit AckBit)
{
	I2C_SDA = AckBit;
	I2C_SCL = 1;
	I2C_SCL = 0;
}

/*******************************************************************************
* 函 数 名		: I2C_ReceiveAck
* 函数功能		: I2C接收应答函数
* 输    入 		: 无
* 输    出		: AckBit（接受应答内容：0表示芯片应答，1表示芯片不应答）
*******************************************************************************/
extern bit I2C_ReceiveAck(void)
{
	bit AckBit;
	I2C_SDA = 1;
	I2C_SCL = 1;
	AckBit = I2C_SDA;
	I2C_SCL = 0;
	return AckBit;
}