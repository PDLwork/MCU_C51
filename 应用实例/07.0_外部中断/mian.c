/*******************************************************************************
实现功能 ：	按下五次按键触发一次下降沿将小灯取反，中断IO口为P3^2;
			外部中断信号可由外部产生也可以由内部产生，本程序用内部产生。	
引脚定义 ：	
*******************************************************************************/

#include <REGX52.H>
#include "UserDef.H"
#include "Delay.H"

INT8U count = 0;
sbit LED1 = P1^1;
sbit LED2 = P1^2;
sbit button = P2^1;

/*******************************************************************************
* 函 数 名		: Int0_Initialization（外部中断0初始化函数）
* 函数功能		: 外部中断初始化
* 输    入 		: 无
* 输    出		: 无
*******************************************************************************/
void Int0_Initialization(void)
{
	EA = 1;		//总中断打开
	EX0 = 1;   	//外部中断0打开
	IT0 = 1;	//0-低电平触发  1-下降沿触发
	IE0 = 0;	//标志位清零
}

/*******************************************************************************
* 函 数 名         :  main主函数
* 函数功能		   :   
* 输    入         :  无
* 输    出         :  无
*******************************************************************************/
void main(void)
{
	Int0_Initialization();  //外部中断初始化
	while(1)
	{
		LED1 = 0;
		if(button == 0)      //检测按键1按下
		{
			DelayXms(10);    //延时消抖
			if(button == 0)
			{
				count++;
				if(count > 4)
				{
					P3_2 = 0;
					DelayXms(1);
					P3_2 = 1;
					count = 0;
				}
			}
			while(button != 1);   //松手检测
		}
	}
}

/*******************************************************************************
* 函 数 名		: Int0_Routine （外部中断0函数）
* 函数功能		: 计数到一定次数发送下降沿执行一次中断程序
* 输    入 		: 无
* 输    出		: 无
*******************************************************************************/
void Int0_Routine(void) interrupt 0
{
		LED2 = !LED2; 
}